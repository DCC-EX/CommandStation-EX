/*
 *  © 2021 Neil McKechnie
 *  © 2020-2021 Harald Barth
 *  © 2020-2026 Chris Harlow
 *  All rights reserved.
 *  
 *  This file is part of CommandStation-EX
 *
 *  This is free software: you can redistribute it and/or modify
 *  it under the terms of the GNU General Public License as published by
 *  the Free Software Foundation, either version 3 of the License, or
 *  (at your option) any later version.
 *
 *  It is distributed in the hope that it will be useful,
 *  but WITHOUT ANY WARRANTY; without even the implied warranty of
 *  MERCHANTABILITY or FITNESS FOR A PARTICULAR PURPOSE.  See the
 *  GNU General Public License for more details.
 *
 *  You should have received a copy of the GNU General Public License
 *  along with CommandStation.  If not, see <https://www.gnu.org/licenses/>.
 */
/**********************************************************************

DCC++ BASE STATION supports Sensor inputs that can be connected to any Arduino Pin
not in use by this program.  Sensors can be of any type (infrared, magentic, mechanical...).
The only requirement is that when "activated" the Sensor must force the specified Arduino
Pin LOW (i.e. to ground), and when not activated, this Pin should remain HIGH (e.g. 5V),
or be allowed to float HIGH if use of the Arduino Pin's internal pull-up resistor is specified.

To ensure proper voltage levels, some part of the Sensor circuitry
MUST be tied back to the same ground as used by the Arduino.

The Sensor code below utilises "de-bounce" logic to remove spikes generated by
mechanical switches and transistors.  This avoids the need to create smoothing circuitry
for each sensor.  You may need to change the parameters through trial and error for your specific sensors.


New for 2026:

Sensor objects monitor sensors for a numbere of purposes.
 1) To inform JMRI or other interested parties of a sensor change
  using <Q id> or <q id>. these are referred everywhere as JMRI sensors for the sake of convenience.
 2) To inform EXRAIL that a sensor has changed and thus ONBUTTON, ONBUTTONUP or ONSENSOR handlers must be called.
 3) To inform the Node manager of a shared sensor change.

JMRI sensors can be created using the semi-obsolete DCC++ <S> commands.  
**********************************************************************/
#include "defines.h"
#include "StringFormatter.h"
#include "CommandDistributor.h"
#include "NodeManager.h"
#include "EXRAIL2.h"
#include "Sensors.h"
#include "IODevice.h"


///////////////////////////////////////////////////////////////////////////////
// checks a number of defined sensors per entry and prints _changed_ sensor state
// to stream unless stream is NULL in which case only internal
// state is updated. Then advances to next sensor which will
// be checked at next invocation.  Each cycle of reading all sensors will
// be initiated no more frequently than the time set by 'cycleInterval' microseconds.
//
// The list of sensors is divided such that the first part of the list
// contains sensors that support change notification via callback, and the second
// part of the list contains sensors that require cyclic polling.  The start of the
// second part of the list is determined from by the 'firstPollSensor' pointer.
///////////////////////////////////////////////////////////////////////////////

void Sensor::loop(){

  uint16_t sensorCount = 0;

  if (firstSensor == NULL) return;  // No sensors to be scanned
  if (readingSensor == NULL) { 
    // Not currently scanning sensor list
    unsigned long thisTime = micros();
    if (thisTime - lastReadCycle >= cycleInterval) {
      // Required time elapsed since last read cycle started,
      // so initiate new scan through the sensor list
      readingSensor = firstSensor;
      lastReadCycle = thisTime;
    }
  }

  // Loop until either end of list is encountered or we pause for some reason
  while (readingSensor != NULL) {
    readingSensor->check();
    readingSensor=readingSensor->nextSensor;
    // Currently process max of 16 sensors per entry.
    // Performance measurements taken during development indicate that, with 128 sensors configured
    // on 8x 16-pin MCP23017 GPIO expanders with polling (no change notification), all inputs can be read from the devices
    // within 1.4ms (400Mhz I2C bus speed), and a full cycle of checking 128 sensors for changes takes under a millisecond.
    if (++sensorCount >= 16) return;
  }
}

void Sensor::check(){
      inputState = IODevice::read(vpin);

    // Check if changed since last time, and process changes.
    if (inputState == active) {
      // no change
      latchDelay = minReadCount; // Reset counter
    } else if (latchDelay > 0) {
      // change detected, but first decrement delay
      latchDelay--;
    } else { 
      // change validated, act on it.
      active = inputState;
      latchDelay = minReadCount;  // Reset counter
      
      // we have discovered a sensor change now decide who to tell
      if (tellJMRI) {
        // if we have throttles, tell them
        CommandDistributor::broadcastSensor(id,active);
        // and tell other nodes about it anyway
        NodeManager::castSensorChange(active?'Q':'q',vpin);
      }
        
      if (tellNodes && !tellJMRI)
        NodeManager::castSensorChange(active?'X':'x',vpin);
      if (tellEXRAIL)
        RMFT2::sensorEvent(vpin,active);
    }
  }

void AnalogSensor::check(){
      analogInputState = IODevice::read(vpin);

    // Check if changed since last time, and process changes.
    if (analogInputState == analogActive) {
      // no change
      latchDelay = minReadCount; // Reset counter
    } else if (latchDelay > 0) {
      // change detected, but first decrement delay
      latchDelay--;
    } else { 
      // change validated, act on it.
      active = analogInputState;
      latchDelay = minReadCount;  // Reset counter
      
      RMFT2::sensorEvent(vpin,analogActive!=0);
    }
  }

void Sensor::shareJMRISensors(){
  for(auto ss=firstSensor;ss;ss=ss->nextSensor){
    if (ss->tellJMRI) NodeManager::castSensorChange(ss->active?'Q':'q',ss->vpin);
  }
}


///////////////////////////////////////////////////////////////////////////////
//
// prints all sensor states to stream
//
///////////////////////////////////////////////////////////////////////////////

void Sensor::printAllJMRI(Print *stream){
  
  if (stream == NULL) return; // Nothing to do
  for(auto ss=firstSensor;ss;ss=ss->nextSensor){
    if (!ss->tellJMRI) continue;
    StringFormatter::send(stream, F("<%c %d>\n"), ss->active ? 'Q' : 'q', ss->id);
  }
} 

void Sensor::dumpAllJMRI(Print *stream){
  
  if (stream == NULL) return; // Nothing to do
  for(auto ss =firstSensor;ss;ss=ss->nextSensor){
    if (!ss->tellJMRI) continue;
    StringFormatter::send(stream, F("<Q %d %d %d>\n"),
      ss->id, ss->vpin,ss->pullUp);
  }
} // Sensor::dumpAll

void Sensor::dumpAll(Print * stream) {
  DIAG(F("DUMP_ALL_SENSORS"));
  for(auto ss =firstSensor;ss;ss=ss->nextSensor) ss->dump(stream);
}

void Sensor::dump(Print * stream) {
  StringFormatter::send(stream, F("<* SENSOR id=%d, vpin=%d %S%S%S%S%S *>\n"), 
    id, vpin,
    pullUp ? F("") : F(" NOPULLUP"),
    tellJMRI ? F(" JMRI") : F(""),
    tellNodes ? F(" SHARE") : F(""),
    tellEXRAIL ? F(" EXRAIL") : F(""),
    acceptREMOTE ? F(" REMOTE") : F(""));
} // Sensor::dump

///////////////////////////////////////////////////////////////////////////////
// Static Function to create/find Sensor object.

Sensor::Sensor(int id, VPIN vpin, bool pullUp){
  nextSensor = firstSensor;
  firstSensor = this;
  this->id = id;
  this->vpin = vpin;
  this->pullUp = pullUp;
  IODevice::configureInput(vpin, pullUp);
  tellJMRI=false;
  tellNodes=false;
  tellEXRAIL=false;
  acceptREMOTE=false;

  active = 0;
  inputState = 0;
  latchDelay = minReadCount;
  DIAG(F("Sensor created: id=%d, vpin=%d, pullUp=%d"), id, vpin, pullUp);
}

// Create multiple jmri sensors based on id and vpin
bool Sensor::createJMRI_SENSOR(VPIN vpin){
  return createJMRIinternal(vpin,vpin,true,1);
}
bool Sensor::createJMRI_SENSOR(VPIN vpin,int count){
  return createJMRIinternal(vpin,vpin,true,count);
}
bool Sensor::createJMRI_SENSOR(VPIN vpin,int count, VPIN newOrigin){
  return createJMRIinternal(newOrigin,vpin,true,count);
}

bool Sensor::createJMRI_SENSOR_NOPULLUP(VPIN vpin){
  return createJMRIinternal(vpin,vpin,false,1);
}
bool Sensor::createJMRI_SENSOR_NOPULLUP(VPIN vpin,int count){
  return createJMRIinternal(vpin,vpin,false,count);
}
bool Sensor::createJMRI_SENSOR_NOPULLUP(VPIN vpin,int count, VPIN newOrigin){
  return createJMRIinternal(newOrigin,vpin,false,count);
}

bool Sensor::createJMRIinternal(int id,VPIN firstPin,bool pullup, int count) {
  DIAG(F("JMRI_SENSOR%S(%d,%d,%d)"), pullup ? F("") : F("_NOPULLUP"), firstPin, count, id);
  for (int slot=0;slot<count;slot++) {
    auto ss=get(id+slot, firstPin+slot);
    if (!ss) ss=new Sensor(id+slot,firstPin+slot,pullup);
    if (!ss) return false;
    ss->tellJMRI=true;
  }
  return true;
}

bool Sensor::createSHARED_SENSOR(VPIN vpin,int count, VPIN newOrigin){
  DIAG(F("SHARED_SENSOR(%d,%d,%d)"), vpin, count, newOrigin);
  for (int slot=0;slot<count;slot++) {
    auto ss=getByVpin(vpin+slot);
    if (!ss) ss=new Sensor(0,vpin+slot,true); 
    if (!ss) return false;
    ss->tellNodes=true;
  }
  return true;
}

bool Sensor::createEXRAIL(VPIN vpin, bool analogue){
  DIAG(F("EXRAIL_SENSOR(%d,%d)"), vpin, analogue);
  if (analogue) {
    auto ss=new AnalogSensor(vpin);
    ss->tellEXRAIL=true;
    return true;
  }
  auto ss=getByVpin(vpin); // EXRAIL sensors have id=vpin
  if (!ss) ss=new Sensor(0,vpin,true);
  ss->tellEXRAIL=true;
  return true;
}

bool Sensor::createREMOTE_SENSOR(VPIN vpin){
  return createREMOTE_SENSOR(vpin,1);
}

bool Sensor::createREMOTE_SENSOR(VPIN vpin,int count){
  // A remote sensor creates a new HAL entry to receive the sensor
  // input from other nodes so that it can be shared with the local system
  DIAG(F("REMOTE_SENSOR(%d,%d)"), vpin, count);
  // create FLAGs HAL for these sensors 
  FLAGS::create(vpin, count);
  for (int slot=0;slot<count;slot++) {
    auto ss=getByVpin(vpin+slot);
    if (!ss) ss=new Sensor(0,vpin+slot,true); 
    if (!ss) return false;
    ss->acceptREMOTE=true;
  }
  return true;
}

// called by nodes manager to say a shared sensor was updated.
// 
void Sensor::updateRemoteSensor(VPIN vpin, bool activate){
  for (auto ss=firstSensor; ss; ss=ss->nextSensor) {
    if (ss->vpin==vpin && ss->acceptREMOTE) {
      IODevice::write(vpin, activate,false);
      return;
    }
  }
}
///////////////////////////////////////////////////////////////////////////////

Sensor* Sensor::getByVpin(VPIN vpin){
  for(auto tt=firstSensor;tt;tt=tt->nextSensor)
    if (tt->vpin==vpin) return tt;
  return nullptr;
}

Sensor* Sensor::getById(int id){
  for(auto tt=firstSensor;tt;tt=tt->nextSensor)
    if (tt->id==id) return tt;
  return nullptr;
}

Sensor* Sensor::get(int id, VPIN vpin){
  // its a pain but <S> commands can alter sensor objects at runtime
  
  for(auto ss=firstSensor;ss!=NULL;ss=ss->nextSensor) {

    if (ss->id==id && ss->vpin==vpin) return ss; // full match 

    if (ss->id==0 && ss->vpin==vpin) { 
      // we can put an id on to a sensor previously created by vpin alone (EXRAIL, NODES)
      ss->id=id; // patch in the id
      return ss;
     }

    if (ss->id==id) {
      // if this is not used by nodes or exrail we can alter the vpin
      if (!ss->tellNodes && !ss->tellEXRAIL) {
        ss->vpin = vpin; // alter the vpin if not used by nodes or exrail
        return ss; // return the altered sensor
      }

      // we have found a sensor with the same id but a different vpin
      // So patch the id off this sensor and allow loop to find 
      // another candidate.
      ss->id=0; // clear the id
      ss->tellJMRI=false;
     }
  }
  return nullptr; // no sensor found 
}

///////////////////////////////////////////////////////////////////////////////

// remove, only removes jmri flag on a sensor. Others cant change at run time 
void Sensor::removeJMRI(int id){
  auto ss=getById(id);
  if (ss) {
    ss->tellJMRI = false;
    ss->id = 0; // clear the id to ease use as different id later
  }
}


///////////////////////////////////////////////////////////////////////////////

Sensor *Sensor::firstSensor=NULL;
Sensor *Sensor::readingSensor=NULL;
unsigned long Sensor::lastReadCycle=0;
